## boards/arm/celeste/Kconfig.defconfig
```kconfig
if BOARD_CELESTE

config BOARD
    default "celeste"

config ZMK_KEYBOARD_NAME
    default "Celeste"

config ZMK_KSCAN_MATRIX_POLLING
    default y

config ZMK_USB
    default y

endif
```

## boards/arm/celeste/celeste_defconfig
```kconfig
CONFIG_BOARD_CELESTE=y

# SoC
CONFIG_SOC_SERIES_STM32L4X=y
CONFIG_SOC_STM32L432XX=y

# 80MHz system clock
CONFIG_SYS_CLOCK_HW_CYCLES_PER_SEC=80000000

# enable GPIO
CONFIG_GPIO=y

# ZMK Settings
CONFIG_ZMK_USB=y
CONFIG_ZMK_KSCAN_MATRIX_POLLING=y
CONFIG_USB_SELF_POWERED=n
CONFIG_ZMK_HID_REPORT_TYPE_NKRO=y

# Needed to reduce this to size that will fit on L432
CONFIG_HEAP_MEM_POOL_SIZE=1024

# clock configuration
CONFIG_CLOCK_CONTROL=y

# enable PINCTRL
CONFIG_PINCTRL=y

CONFIG_ARM_MPU=y
CONFIG_HW_STACK_PROTECTION=y

# Key scanning
CONFIG_ZMK_KSCAN_MATRIX_POLLING=y
CONFIG_ZMK_KSCAN_MATRIX_WAIT_BETWEEN_OUTPUTS=30

# Storage
CONFIG_FLASH=y
CONFIG_FLASH_MAP=y
CONFIG_NVS=y
CONFIG_SETTINGS=y

# USB
CONFIG_USB_DEVICE_MANUFACTURER="Keychron"
CONFIG_USB_DEVICE_PRODUCT="Q8"

# Use the STRIP config specific to the LEDs you're using
# NOTE: This is required for extrnal module, zmk-ckled2001
CONFIG_ZMK_RGB_UNDERGLOW=y
CONFIG_ZMK_RGB_UNDERGLOW_EXT_POWER=n
CONFIG_ZMK_RGB_UNDERGLOW_EFF_START=3
CONFIG_ZMK_RGB_UNDERGLOW_BRT_START=80
CONFIG_ZMK_RGB_UNDERGLOW_AUTO_OFF_IDLE=y
CONFIG_LED_STRIP_INIT_PRIORITY=81

# Encoder
CONFIG_EC11=y
CONFIG_EC11_TRIGGER_GLOBAL_THREAD=y
```

## boards/arm/keychron_q8/Kconfig.defconfig
```kconfig
if BOARD_KEYCHRON_Q8

config BOARD
    default "keychron_q8"

config ZMK_KEYBOARD_NAME
    default "Keychron Q8"

config ZMK_KSCAN_MATRIX_POLLING
    default y

config ZMK_USB
    default y

endif
```

## boards/arm/keychron_q8/keychron_q8_defconfig
```kconfig
CONFIG_BOARD_KEYCHRON_Q8=y

# SoC
CONFIG_SOC_SERIES_STM32L4X=y
CONFIG_SOC_STM32L432XX=y

# 80MHz system clock
CONFIG_SYS_CLOCK_HW_CYCLES_PER_SEC=80000000

# enable GPIO
CONFIG_GPIO=y

# ZMK Settings
CONFIG_ZMK_USB=y
CONFIG_ZMK_KSCAN_MATRIX_POLLING=y
CONFIG_USB_SELF_POWERED=n
CONFIG_ZMK_USB_LOGGING=y
CONFIG_ZMK_HID_REPORT_TYPE_NKRO=y

# Needed to reduce this to size that will fit on L432
CONFIG_HEAP_MEM_POOL_SIZE=1024

# clock configuration
CONFIG_CLOCK_CONTROL=y

# enable PINCTRL
CONFIG_PINCTRL=y

CONFIG_ARM_MPU=y
CONFIG_HW_STACK_PROTECTION=y

# Key scanning
CONFIG_ZMK_KSCAN_MATRIX_POLLING=y
CONFIG_ZMK_KSCAN_MATRIX_WAIT_BETWEEN_OUTPUTS=30

# Storage
CONFIG_FLASH=y
CONFIG_FLASH_MAP=y
CONFIG_NVS=y
CONFIG_SETTINGS=y

# USB
CONFIG_USB_DEVICE_MANUFACTURER="Keychron"
CONFIG_USB_DEVICE_PRODUCT="Q8"
```

## boards/shields/calypso/Kconfig.defconfig
```kconfig
if SHIELD_CALYPSO_LEFT
  config ZMK_KEYBOARD_NAME
    default "Calypso"

  config ZMK_SPLIT_ROLE_CENTRAL
    default y
endif

if SHIELD_CALYPSO_LEFT || SHIELD_CALYPSO_RIGHT
  config ZMK_SPLIT
    default y
endif
```

## boards/shields/calypso/Kconfig.shield
```kconfig
config SHIELD_CALYPSO_LEFT
  def_bool $(shields_list_contains,calypso_left)

config SHIELD_CALYPSO_RIGHT
  def_bool $(shields_list_contains,calypso_right)
```

## boards/shields/eros/Kconfig.defconfig
```kconfig
if SHIELD_CALYPSO_LEFT
  config ZMK_KEYBOARD_NAME
    default "Calypso"

  config ZMK_SPLIT_ROLE_CENTRAL
    default y

  # battery fetching from peripheral
  config ZMK_SPLIT_BLE_CENTRAL_BATTERY_LEVEL_FETCHING
    default y
  config ZMK_SPLIT_BLE_CENTRAL_BATTERY_LEVEL_PROXY
    default y

  config SPI
    default y
endif

if SHIELD_CALYPSO_LEFT || SHIELD_CALYPSO_RIGHT
  config ZMK_SPLIT
    default y
endif
```

## boards/shields/eros/Kconfig.shield
```kconfig
config SHIELD_CALYPSO_LEFT
  def_bool $(shields_list_contains,eros_left)

config SHIELD_CALYPSO_RIGHT
  def_bool $(shields_list_contains,eros_right)
```

## boards/shields/helios/Kconfig.defconfig
```kconfig
if SHIELD_HELIOS

config ZMK_KEYBOARD_NAME
  default "Helios"

config BUILD_OUTPUT_UF2_USE_FLASH_BASE
  default y

config BUILD_OUTPUT_UF2_USE_FLASH_OFFSET
  default y


if SOC_FAMILY_STM32

config ZMK_KSCAN_MATRIX_WAIT_BEFORE_INPUTS
    default 150

config ZMK_KSCAN_MATRIX_WAIT_BETWEEN_OUTPUTS
    default 150

endif

endif
```

## boards/shields/lynx/Kconfig.defconfig
```kconfig
if SHIELD_LYNX_DONGLE
  config ZMK_KEYBOARD_NAME
    default "Lynx"

  config ZMK_SPLIT_ROLE_CENTRAL
    default y

  config ZMK_USB
    default y

  config ZMK_SPLIT_BLE_CENTRAL_PERIPHERALS
    default 2

  config BT_MAX_CONN
    default 6

  config BT_MAX_PAIRED
    default 6
endif

if SHIELD_LYNX_DONGLE || SHIELD_LYNX_LEFT || SHIELD_LYNX_RIGHT
  config ZMK_SPLIT
    default y

  config ZMK_BLE
    default y
endif
```

## boards/shields/lynx/Kconfig.shield
```kconfig
config SHIELD_LYNX_DONGLE
  def_bool $(shields_list_contains,lynx_dongle)

config SHIELD_LYNX_LEFT
  def_bool $(shields_list_contains,lynx_left)

config SHIELD_LYNX_RIGHT
  def_bool $(shields_list_contains,lynx_right)
```

## boards/shields/selene/Kconfig.defconfig
```kconfig
if SHIELD_SELENE_DONGLE
  config ZMK_KEYBOARD_NAME
    default "Selene"

  config ZMK_SPLIT_ROLE_CENTRAL
    default y

  config ZMK_USB
    default y

  config ZMK_SPLIT_BLE_CENTRAL_PERIPHERALS
    default 2

  config BT_MAX_CONN
    default 5

  config BT_MAX_PAIRED
    default 5

  # battery fetching from peripheral
  config ZMK_SPLIT_BLE_CENTRAL_BATTERY_LEVEL_FETCHING
    default y

  # config ZMK_SPLIT_BLE_CENTRAL_BATTERY_LEVEL_PROXY
  #   default y
endif

if SHIELD_SELENE_DONGLE || SHIELD_SELENE_LEFT || SHIELD_SELENE_RIGHT
  config ZMK_SPLIT
    default y

  config ZMK_BLE
    default y
endif
```

## boards/shields/selene/Kconfig.shield
```kconfig
config SHIELD_SELENE_DONGLE
  def_bool $(shields_list_contains,selene_dongle)

config SHIELD_SELENE_LEFT
  def_bool $(shields_list_contains,selene_left)

config SHIELD_SELENE_RIGHT
  def_bool $(shields_list_contains,selene_right)
```
