/*                KEY POSITIONS
34 keys:

  ╭────────────────────╮ ╭────────────────────╮
  │  0   1   2   3   4 │ │  5   6   7   8   9 │
  │ 10  11  12  13  14 │ │ 15  16  17  18  19 │
  │ 20  21  22  23  24 │ │ 25  26  27  28  29 │
  ╰───────────╮ 30  31 │ │ 32  33 ╭───────────╯
              ╰────────╯ ╰────────╯
*/

/ {
    combos {
      compatible = "zmk,combos";
      combo_bspc {
        timeout-ms = <40>;
        bidings = <&kp BSPC>;
        key-position = <6 7>;
        layers = <DEF>;
        require-prior-idle-ms = <100>;
      };
    };
};
