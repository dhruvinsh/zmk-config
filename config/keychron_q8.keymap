// vim: set ts=4 sw=4 ft=devicetree:

/*                KEY POSITIONS

  RC(4,4)
  RC(0,0) RC(0,1) RC(0,2) RC(0,3) RC(0,4) RC(0,5) RC(0,6) RC(0,7) RC(0,8) RC(0,9) RC(0,10) RC(0,11) RC(0,12) RC(0,13)          RC(0,14)
  RC(1,0) RC(1,1) RC(1,2) RC(1,3) RC(1,4) RC(1,5) RC(1,6) RC(1,7) RC(1,8) RC(1,9) RC(1,10) RC(1,11) RC(1,12) RC(1,13)          RC(1,14)
  RC(2,0) RC(2,1) RC(2,2) RC(2,3) RC(2,4) RC(2,5)         RC(2,7) RC(2,8) RC(2,9) RC(2,10) RC(2,11) RC(2,12) RC(2,13)          RC(2,14)
  RC(3,0)         RC(3,2) RC(3,3) RC(3,4) RC(3,5) RC(3,6) RC(3,7) RC(3,8) RC(3,9) RC(3,10) RC(3,11) RC(3,12) RC(3,13) RC(3,14)
  RC(4,0) RC(4,1) RC(4,2)         RC(4,3)         RC(4,6) RC(4,7)         RC(4,8)          RC(4,9)           RC(4,12) RC(4,13) RC(4,14)

 SW
 ╭───────────────────────────╮ ╭───────────────────────────────────────╮
 │ 1   2   3   4   5   6   7 │ │   8   9   10   11  12  13  14  15     │
 │ 16  17   18  19  20  21   │ │ 22  23  24  25    26  27  28  29  30  │
 │ 31  32   33  34  35  36   │ │  37  38  39  40    41  42   43    44  │
 │ 45   46   47  48  49  50  │ │51  52  53  54  55   56   57    58     │
 │ 59  60    61    62     63 │ │ 64    65     66            67  68  69 │
 ╰───────────────────────────╯ ╰───────────────────────────────────────╯

 ╭───────────────────────────╮ ╭───────────────────────────────────────╮
 │                           │ │                                       │
 │     LT4  LT3 LT2 LT1 LT0  │ │ RT0 RT1 RT2 RT3   RT4 RT5             │
 │     LM4  LM3 LM2 LM1 LM0  │ │  RM0 RM1 RM2 RM3   RM4                │
 │      LB4  LB3 LB2 LB1 LB0 │ │    RB0 RB1 RB2 RB3  RB4               │
 │                 LH1    LH0│ │ RH0   RH1                             │
 ╰───────────────────────────╯ ╰───────────────────────────────────────╯
*/

// Some config for keyboard
#define CONFIG_ENCODER

/* key positions */
#define LT0  21  // left-top row
#define LT1  20
#define LT2  19
#define LT3  18
#define LT4  17

#define RT0  22  // right-top row
#define RT1  23
#define RT2  24
#define RT3  25
#define RT4  26

#define LM0  36  // left-middle row
#define LM1  35
#define LM2  34
#define LM3  33
#define LM4  32

#define RM0  37  // right-middle row
#define RM1  38
#define RM2  39
#define RM3  40
#define RM4  41

#define LB0  50  // left-bottom row
#define LB1  49
#define LB2  48
#define LB3  47
#define LB4  46

#define RB0  52  // right-bottom row
#define RB1  53
#define RB2  54
#define RB3  55
#define RB4  56

#define LH0  63  // left thumb keys
#define LH1  62

#define RH0  64  // right thumb keys
#define RH1  65

/* kinesis extra keys */
#define X_LT    &mo QWE \
                &kp ESC &kp N1 &kp N2 &kp N3 &kp N4 &kp N5 &kp N6     &kp N7 &kp N8 &kp N9 &kp N0 &kp MINUS &kp EQUAL &kp BSPC &kp C_MUTE \
                &kp TAB
#define X_LM    &kp CAPS
#define X_LB    &kp LSHFT
#define X_LH    &kp LCTRL &kp LGUI &kp LALT

#define X_MB    XXX

#define X_RT    &kp LBKT &kp RBKT &kp BSLH &kp DEL
#define X_RM    &kp SQT &kp ENTER &kp HOME
#define X_RB    &kp RSHFT &kp UP
#define X_RH    &kp RALT &kp LEFT &kp DOWN &kp RIGHT

#include "include/base.dtsi"
