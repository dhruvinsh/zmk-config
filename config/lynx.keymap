// vim: set ts=4 sw=4 ft=devicetree:

/*                KEY POSITIONS

  RC(0,0) RC(0,1) RC(0,2) RC(0,3) RC(0,4)   RC(0,5) RC(0,6) RC(0,7) RC(0,8) RC(0,9)
  RC(1,0) RC(1,1) RC(1,2) RC(1,3) RC(1,4)   RC(1,5) RC(1,6) RC(1,7) RC(1,8) RC(1,9)
  RC(2,0) RC(2,1) RC(2,2) RC(2,3) RC(2,4)   RC(2,5) RC(2,6) RC(2,7) RC(2,8) RC(2,9)
                          RC(3,3) RC(3,4)   RC(3,5) RC(3,6)

34 keys:

  ╭────────────────────┬────────────────────╮
  │  0   1   2   3   4 │  5   6   7   8   9 │
  │ 10  11  12  13  14 │ 15  16  17  18  19 │
  │ 20  21  22  23  24 │ 25  26  27  28  29 │
  ╰───────────╮ 30  31 │ 32  33 ╭───────────╯
              ╰────────┴────────╯
 ╭─────────────────────┬─────────────────────╮
 │ LT4 LT3 LT2 LT1 LT0 │ RT0 RT1 RT2 RT3 RT4 │
 │ LM4 LM3 LM2 LM1 LM0 │ RM0 RM1 RM2 RM3 RM4 │
 │ LB4 LB3 LB2 LB1 LB0 │ RB0 RB1 RB2 RB3 RB4 │
 ╰───────────╮ LH1 LH0 │ RH0 RH1 ╭───────────╯
             ╰─────────┴─────────╯
*/

// Some config for keyboard
#define CONFIG_WIRELESS

/* key positions */
#define LT0  4  // left-top row
#define LT1  3
#define LT2  2
#define LT3  1
#define LT4  0

#define RT0  5  // right-top row
#define RT1  6
#define RT2  7
#define RT3  8
#define RT4  9

#define LM0 14  // left-middle row
#define LM1 13
#define LM2 12
#define LM3 11
#define LM4 10

#define RM0 15  // right-middle row
#define RM1 16
#define RM2 17
#define RM3 18
#define RM4 19

#define LB0 24  // left-bottom row
#define LB1 23
#define LB2 22
#define LB3 21
#define LB4 20

#define RB0 25  // right-bottom row
#define RB1 26
#define RB2 27
#define RB3 28
#define RB4 29

#define LH0 31  // left thumb keys
#define LH1 30

#define RH0 32  // right thumb keys
#define RH1 33

#include "include/base.dtsi"
