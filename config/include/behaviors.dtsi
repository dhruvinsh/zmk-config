// vim: set ts=4 sw=4 ft=devicetree:

#include <behaviors.dtsi>
#include <dt-bindings/zmk/keys.h>

&sk {
    release-after-ms = <1500>;
    quick-release;
};

// Alt+Tab swapper
/ {
    behaviors {
        swapper: swapper {
            compatible = "zmk,behavior-tri-state";
            #binding-cells = <0>;
            bindings = <&kt LALT>, <&kp TAB>, <&kt LALT>;
        };
    };
};
